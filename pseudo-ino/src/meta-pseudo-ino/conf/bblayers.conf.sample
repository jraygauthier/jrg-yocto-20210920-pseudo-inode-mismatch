## pseudo-ino/src/meta-pseudo-ino/conf/bblayers.conf.sample
```bitbake
POKY_BBLAYERS_CONF_VERSION = "2"
BBPATH = "${TOPDIR}"
BBFILES ?= ""

YOCTOROOT = "${@os.path.abspath(os.path.join("${TOPDIR}", os.pardir))}"
YOCTOSRC = "${YOCTOROOT}/src"

BBLAYERS ?= " \
  ${YOCTOSRC}/poky/meta \
  ${YOCTOSRC}/poky/meta-poky \
  ${YOCTOSRC}/meta-openembedded/meta-oe \
  ${YOCTOSRC}/meta-openembedded/meta-python \
  ${YOCTOSRC}/meta-openembedded/meta-networking \
  ${YOCTOSRC}/meta-pseudo-ino \
"
```

## pseudo-ino/src/meta-pseudo-ino/conf/distro/pseudo-ino-linux.conf
```bitbake
DISTRO = "pseudo-ino-linux"
DISTRO_NAME = "PseudoInoLinux"
DISTRO_VERSION = "0.0.0"
DISTRO_CODENAME = "hardknott"
SDK_VENDOR = "-pokysdk"
SDK_VERSION = "${@d.getVar('DISTRO_VERSION').replace('snapshot-${METADATA_REVISION}', 'snapshot')}"
SDK_VERSION[vardepvalue] = "${SDK_VERSION}"

MAINTAINER = "Amotus Solutions <jraygauthier@gmail.com>"

TARGET_VENDOR = "-poky"

LOCALCONF_VERSION = "1"

DISTRO_VERSION[vardepsexclude] = "DATE"
SDK_VERSION[vardepsexclude] = "DATE"

# Override these in poky based distros
POKY_DEFAULT_EXTRA_RDEPENDS = "packagegroup-core-boot"
POKY_DEFAULT_EXTRA_RRECOMMENDS = "kernel-module-af-packet"

PINO_DISTRO_FEATURES_DEFAULT = "acl agrp ext2 largefile usbgadget usbhost wifi bluetooth xattr ptest multiarch"

DISTRO_FEATURES ?= "${PINO_DISTRO_FEATURES_DEFAULT} ${DISTRO_FEATURES_LIBC} ${POKY_DEFAULT_DISTRO_FEATURES}"

# Strip down the distro so that any unused features are removed.
DISTRO_FEATURES_remove = "3g irda nfc opengl pci pcmcia pulseaudio sysvinit vulkan wayland x11 zeroconf"
DISTRO_FEATURES_BACKFILL_CONSIDERED += "pulseaudio"

# Using systemd instead of sysvinit.
DISTRO_FEATURES_append = " systemd wifi bluetooth usbhost"
DISTRO_FEATURES_remove = "sysvinit"
DISTRO_FEATURES_BACKFILL_CONSIDERED += "sysvinit"
VIRTUAL-RUNTIME_init_manager = "systemd"
VIRTUAL-RUNTIME_initscripts = "systemd-compat-units"

# TODO: Would prefer to have the in the image recipes.
# Move it there once we have the common inc file.
# See 'system-shell-cfg' as to why this is required.
# Unfortunatly it does not seem to be possible to add
# these to a normal recipe so that everything is held
# in one place.
INHERIT += "extrausers"
EXTRA_USERS_PARAMS = "usermod --shell /bin/bash root;"

SDK_NAME = "${DISTRO}-${TCLIBC}-${SDKMACHINE}-${IMAGE_BASENAME}-${TUNE_PKGARCH}-${MACHINE}"
SDKPATH = "/opt/${DISTRO}/${SDK_VERSION}"

DISTRO_EXTRA_RDEPENDS += "${POKY_DEFAULT_EXTRA_RDEPENDS}"
DISTRO_EXTRA_RRECOMMENDS += "${POKY_DEFAULT_EXTRA_RRECOMMENDS}"

TCLIBCAPPEND = ""

PREMIRRORS ??= "\
bzr://.*/.*   http://downloads.yoctoproject.org/mirror/sources/ \n \
cvs://.*/.*   http://downloads.yoctoproject.org/mirror/sources/ \n \
git://.*/.*   http://downloads.yoctoproject.org/mirror/sources/ \n \
gitsm://.*/.* http://downloads.yoctoproject.org/mirror/sources/ \n \
hg://.*/.*    http://downloads.yoctoproject.org/mirror/sources/ \n \
osc://.*/.*   http://downloads.yoctoproject.org/mirror/sources/ \n \
p4://.*/.*    http://downloads.yoctoproject.org/mirror/sources/ \n \
svn://.*/.*   http://downloads.yoctoproject.org/mirror/sources/ \n"

SANITY_TESTED_DISTROS ?= " \
            poky-3.2 \n \
            poky-3.3 \n \
            ubuntu-16.04 \n \
            ubuntu-18.04 \n \
            ubuntu-20.04 \n \
            fedora-31 \n \
            fedora-32 \n \
            fedora-33 \n \
            centos-7 \n \
            centos-8 \n \
            debian-8 \n \
            debian-9 \n \
            debian-10 \n \
            opensuseleap-15.1 \n \
            opensuseleap-15.2 \n \
            "
# add poky sanity bbclass
INHERIT += "poky-sanity"

# QA check settings - a little stricter than the OE-Core defaults
# (none currently necessary as we now match OE-Core)
#WARN_TO_ERROR_QA = "X"
#WARN_QA_remove = "${WARN_TO_ERROR_QA}"
#ERROR_QA_append = " ${WARN_TO_ERROR_QA}"

require conf/distro/include/poky-world-exclude.inc
require conf/distro/include/no-static-libs.inc
require conf/distro/include/yocto-uninative.inc
require conf/distro/include/security_flags.inc
INHERIT += "uninative"

INHERIT += "reproducible_build"

BB_SIGNATURE_HANDLER ?= "OEEquivHash"
BB_HASHSERVE ??= "auto"
```

## pseudo-ino/src/meta-pseudo-ino/conf/layer.conf
```bitbake
# We have a conf and classes directory, add to BBPATH
BBPATH .= ":${LAYERDIR}"

# We have recipes-* directories, add to BBFILES
BBFILES += "\
    ${LAYERDIR}/recipes-*/*/*.bb \
    ${LAYERDIR}/recipes-*/*/*.bbappend \
    ${LAYERDIR}/meta-*/recipes-*/*/*.bb \
    ${LAYERDIR}/meta-*/recipes-*/*/*.bbappend \
    ${LAYERDIR}/meta/recipes-*/*/*.bb \
    ${LAYERDIR}/meta/recipes-*/*/*.bbappend \
"

BBFILE_COLLECTIONS += "pseudo-ino-layer"
BBFILE_PATTERN_pseudo-ino-layer = "^${LAYERDIR}/"
BBFILE_PRIORITY_pseudo-ino-layer = "10"
LAYERSERIES_COMPAT_pseudo-ino-layer = "hardknott"
```

## pseudo-ino/src/meta-pseudo-ino/conf/local.conf.sample
```bitbake
# Shared between all builds
DL_DIR ?= "/downloads"

# Shared between all builds
SSTATE_DIR ?= "/sstate-cache"

#
# The set of conf variable that can be customized
# via environment variables.
# This is only possible because of `BB_ENV_EXTRAWHITE`
# env var extended by our docker's entry point.
# `.docker/entry-point/inner.sh`.
#
MACHINE ?= "qemux86-64"

# Allow developers to have guarded section
# diverging from official builds
# Please prefix variants by 'dev' so that the
# nature of the build is made clear in the name of the
# tmp dir (e.g.: 'dev-myname' or 'dev-with-my-feat', etc).
# It might also simply be 'dev'.
# 'official' should be the pristine and reproducible
# official build / release value (i.e: no dev variants).
LOCALCONF_FLAVOR ?= "official"

# Allow us to create separate build outputs for
# variants of the build. Useful for experiments.
TMPDIR_SUFFIX ?= ""

# Note how the above customization are reflected in the output dir.
# This prevent a variant from overriding another.
TMPDIR = "${YOCTOROOT}/build/tmp-${MACHINE}-${LOCALCONF_FLAVOR}${TMPDIR_SUFFIX}"

# DISTRO ?= "poky"
DISTRO ?= "pseudo-ino-linux"
PACKAGE_CLASSES ?= "package_rpm"
EXTRA_IMAGE_FEATURES ?= "debug-tweaks"
USER_CLASSES ?= "buildstats image-mklibs image-prelink"
PATCHRESOLVE = "noop"
BB_DISKMON_DIRS = "\
    STOPTASKS,${TMPDIR},1G,100K \
    STOPTASKS,${DL_DIR},1G,100K \
    STOPTASKS,${SSTATE_DIR},1G,100K \
    STOPTASKS,/tmp,100M,100K \
    ABORT,${TMPDIR},100M,1K \
    ABORT,${DL_DIR},100M,1K \
    ABORT,${SSTATE_DIR},100M,1K \
    ABORT,/tmp,10M,1K"
PACKAGECONFIG_append_pn-qemu-native = " sdl"
PACKAGECONFIG_append_pn-nativesdk-qemu = " sdl"
CONF_VERSION = "1"
OE_TERMINAL = "screen"
ACCEPT_FSL_EULA = "1"
```
